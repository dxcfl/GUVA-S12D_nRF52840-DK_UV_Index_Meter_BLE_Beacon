## CMakeLists.txt
```
#
# Copyright (c) 2024 Nordic Semiconductor
#
# SPDX-License-Identifier: LicenseRef-Nordic-5-Clause
#

cmake_minimum_required(VERSION 3.20.0)
find_package(Zephyr REQUIRED HINTS $ENV{ZEPHYR_BASE})

project(GUVA-S12D_UV_Index_Meter_BLE_Beacon)

target_include_directories(app PRIVATE 
    src
)

target_sources(app PRIVATE 
    src/main.c 
    src/beacon.c 
    src/beacon.h
    src/GUVA_S12SD.c
    src/GUVA_S12SD.h
)
```

## Kconfig
```
source "Kconfig.zephyr"

config BEACON_UPDATE_INTERVAL
  int "Beacon updated interval in milliseconds"
  default 1000
```

## prj.conf
```kconfig
#
# Copyright (c) 2024 Nordic Semiconductor
#
# SPDX-License-Identifier: LicenseRef-Nordic-5-Clause
#

CONFIG_ADC=y
CONFIG_BT=y
#CONFIG_LOG=y
CONFIG_BT_DEVICE_NAME="UV_INDEX"
CONFIG_PICOLIBC_IO_FLOAT=y
CONFIG_BEACON_UPDATE_INTERVAL=10000
```

## boards/nrf52840dk_nrf52840.overlay
```dts
/*
 * SPDX-License-Identifier: Apache-2.0
 *
 * Copyright (c) 2022 Nordic Semiconductor ASA
 */


/ {
	zephyr,user {
		io-channels = <&adc 0>;
	};
};

&adc {
	#address-cells = <1>;
	#size-cells = <0>;
	status = "okay";
	channel@0 {
		reg = <0>;
		zephyr,gain = "ADC_GAIN_1_6";
		zephyr,reference = "ADC_REF_INTERNAL";
		zephyr,acquisition-time = <ADC_ACQ_TIME_DEFAULT>;
		zephyr,input-positive = <NRF_SAADC_AIN1>; /* P0.02 for nRF52xx, P0.04 for nRF53xx */
		zephyr,resolution = <12>;
	};
};
```

## boards/nrf52dk_nrf52832.overlay
```dts
/*
 * SPDX-License-Identifier: Apache-2.0
 *
 * Copyright (c) 2022 Nordic Semiconductor ASA
 */

/ {
	zephyr,user {
		io-channels = <&adc 0>;
	};
};

&adc {
	#address-cells = <1>;
	#size-cells = <0>;
	status = "okay";
	channel@0 {
		reg = <0>;
		zephyr,gain = "ADC_GAIN_1_6";
		zephyr,reference = "ADC_REF_INTERNAL";
		zephyr,acquisition-time = <ADC_ACQ_TIME_DEFAULT>;
		zephyr,input-positive = <NRF_SAADC_AIN0>; /* P0.02 for nRF52xx, P0.04 for nRF53xx */
		zephyr,resolution = <12>;
	};
};
```

## boards/nrf7002dk_nrf5340_cpuapp_ns.overlay
```dts
/*
 * SPDX-License-Identifier: Apache-2.0
 *
 * Copyright (c) 2022 Nordic Semiconductor ASA
 */


/ {
	zephyr,user {
		io-channels = <&adc 0>;
	};
};

&adc {
	#address-cells = <1>;
	#size-cells = <0>;
	status = "okay";
	channel@0 {
		reg = <0>;
		zephyr,gain = "ADC_GAIN_1_6";
		zephyr,reference = "ADC_REF_INTERNAL";
		zephyr,acquisition-time = <ADC_ACQ_TIME_DEFAULT>;
		zephyr,input-positive = <NRF_SAADC_AIN0>; /* P0.02 for nRF52xx, P0.04 for nRF53xx */
		zephyr,resolution = <12>;
	};
};
```

## boards/nrf9160dk_nrf9160_ns.overlay
```dts
/*
 * SPDX-License-Identifier: Apache-2.0
 *
 * Copyright (c) 2022 Nordic Semiconductor ASA
 */


/ {
	zephyr,user {
		io-channels = <&adc 0>;
	};
};

&adc {
	#address-cells = <1>;
	#size-cells = <0>;
	status = "okay";
	channel@0 {
		reg = <0>;
		zephyr,gain = "ADC_GAIN_1_6";
		zephyr,reference = "ADC_REF_INTERNAL";
		zephyr,acquisition-time = <ADC_ACQ_TIME_DEFAULT>;
		zephyr,input-positive = <NRF_SAADC_AIN0>; /* P0.13 for nRF9160*/
		zephyr,resolution = <12>;
	};
};
```

## src/main.c
```c
/* main.c - UV index meter beacon w/ GUVA-S12SD UV sensor */

/* Copyright (c) 2024 dxcfl
 * Based on the Nordic SDK examples Copyright (c) 2024 Nordic Semiconductor ASA 
 * 
 * SPDX-License-Identifier: LicenseRef-Nordic-5-Clause
 */

#include <zephyr/kernel.h>
#include <zephyr/device.h>
#include <zephyr/devicetree.h>
#include <zephyr/logging/log.h>
#include <zephyr/drivers/adc.h>

#include <GUVA_S12SD.h>
#include <beacon.h>

#define SLEEP_TIME CONFIG_BEACON_UPDATE_INTERVAL


/* Auxiliary function: Format UV index value as a string.
 *
 * @param uv_index UV index value.
 *
 * @return UV index value as a string.
 */
static const char *uv_index_str(float uv_index)
{
	static char buf[16];
	snprintf(buf, sizeof(buf), "UV index: %.1f", uv_index);
	return buf;
}

/* Auxiliary function: Format UV index value as a string.
 *
 * @param uv_index UV index value.
 *
 * @return UV index value as a string.
 */
static const char *uv_index_short_str(float uv_index)
{
	static char buf[16];
	snprintf(buf, sizeof(buf), "UVI=%.1f", uv_index);
	return buf;
}

/* a variable of type adc_dt_spec for each channel ...*/
static const struct adc_dt_spec adc_channel = ADC_DT_SPEC_GET(DT_PATH(zephyr_user));

LOG_MODULE_REGISTER(UV_meter_beacon, LOG_LEVEL_DBG);

int main(void)
{
	int err;
	uint32_t count = 0;

	/* a variable of type adc_sequence and a buffer of type uint16_t ...*/
	int16_t buf;
	struct adc_sequence sequence = {
		.buffer = &buf,
		/* buffer size in bytes, not number of samples */
		.buffer_size = sizeof(buf),
		// Optional
		//.calibrate = true,
	};

	/* validate that the ADC peripheral (SAADC) is ready ...*/
	if (!adc_is_ready_dt(&adc_channel))
	{
		LOG_ERR("ADC controller devivce %s not ready", adc_channel.dev->name);
		return 0;
	}
	/* setup the ADC channel ...*/
	err = adc_channel_setup_dt(&adc_channel);
	if (err < 0)
	{
		LOG_ERR("Could not setup channel #%d (%d)", 0, err);
		return 0;
	}
	/* initialize the ADC sequence ...*/
	err = adc_sequence_init_dt(&adc_channel, &sequence);
	if (err < 0)
	{
		LOG_ERR("Could not initalize sequnce");
		return 0;
	}

	/* start the BLE beacon ...*/
	LOG_INF("Starting BLE beacon ...");
	beacon_start();

	LOG_INF("Starting read & update loop ...");
	while (1)
	{
		int val_mv;

		/* read a sample from the ADC ...*/
		err = adc_read(adc_channel.dev, &sequence);
		if (err < 0)
		{
			LOG_ERR("Could not read (%d)", err);
			continue;
		}

		val_mv = (int)buf;
		LOG_INF("ADC reading[%u]: %s, channel %d: Raw: %d", count++, adc_channel.dev->name,
				adc_channel.channel_id, val_mv);

		/* convert raw value to mV ...*/
		err = adc_raw_to_millivolts_dt(&adc_channel, &val_mv);
		/* conversion to mV may not be supported, skip if not */
		if (err < 0)
		{
			LOG_WRN(" (value in mV not available)\n");
		}
		else
		{
			float uv_index;
			const char *beacon_name_short;
			const char *beacon_name_complete;

			LOG_INF(" = %d mV", val_mv);
			/* calculate UV index ...*/
			uv_index = GUVA_S12SD_uv_index(val_mv);
			LOG_INF("UV index = %.1f", uv_index);

			/* update the beacon's name ...*/
			beacon_name_short = uv_index_short_str(uv_index);
			beacon_name_complete = uv_index_str(uv_index);
			LOG_INF("Updating beacon name ...");
			beacon_update_names(beacon_name_complete,strlen(beacon_name_complete),beacon_name_short,strlen(beacon_name_short));
		}

		LOG_INF("Sleeping %d msec ...",SLEEP_TIME);
		k_sleep(K_MSEC(SLEEP_TIME));
	}
	return 0;
}
```

## src/GUVA_S12SD.c
```c
/*
 * Copyright (C) 2024  dxcfl
 *
 * SPDX-License-Identifier: Apache-2.0
 *
 * GUVA-S12SD auxilliary functions
 *
 */

#include <GUVA_S12SD.h> 

/* GUVA_S12SD_UV_INDEX
Function to convert sensor output voltage (mV) to UV index
for a GUVA-S12SD based analog UV sensor based on a conversion table.
See http://www.esp32learning.com/code/esp32-and-guva-s12sd-uv-sensor-example.php
for conversion table ...
*/
float GUVA_S12SD_uv_index(float mv)
{
    const float mv_uvi[12] = {50, 227, 318, 408, 503, 606, 696, 795, 881, 976, 1079, 1170};
    int i = 0;
    float uvi = 0;

    if ( mv < 1 ) return 0; // if mv is less than 1 mV, return 0

    for (i = 0; i < 12; i++)
    {
        if (mv < mv_uvi[i])
            break;
    }
    if (i < 11)
    {
        uvi = mv / mv_uvi[i] * (i + 1);
    }
    else
    {
        uvi = 11;
    }

    return uvi;
}

/* GUVA_S12SD_UV_LEVEL
Function to convert sensor output voltage (mV) to mW/m^2
for a GUVA-S12SD based analog UV sensor: "The output voltage is: Vo = 4.3 * Diode-Current-in-uA.
So if the photocurrent is 1uA (9 mW/cm^2), the output voltage is 4.3V."
*/
float GUVA_S12SD_uv_level(float mv)
{
    float uv_level = mv / 43 * 9; // 1 uA per 9 mW/cm^2 at 4.3V
    return uv_level;
}
```

## src/GUVA_S12SD.h
```c
/*
 * Copyright (C) 2024  dxcfl
 *
 * SPDX-License-Identifier: Apache-2.0
 *
 * GUVA-S12SD auxilliary functions
 *
 */

#ifndef _GUVA_S12SD_H
#define _GUVA_S12SD_H

/* GUVA_S12SD_UV_INDEX
Function to convert sensor output voltage (mV) to UV index
for a GUVA-S12SD based analog UV sensor based on a conversion table.
See http://www.esp32learning.com/code/esp32-and-guva-s12sd-uv-sensor-example.php
for conversion table ...
*/
float GUVA_S12SD_uv_index(float mv);

/* GUVA_S12SD_UV_LEVEL
Function to convert sensor output voltage (mV) to mW/m^2
for a GUVA-S12SD based analog UV sensor: "The output voltage is: Vo = 4.3 * Diode-Current-in-uA.
So if the photocurrent is 1uA (9 mW/cm^2), the output voltage is 4.3V."
*/
float GUVA_S12SD_uv_level(float mv);

#endif // _GUVA_S12SD_H
```

## src/beacon.c
```c
/* beacon.c - BLE beacon */

/*
 * Copyright (c) 2015-2016 Intel Corporation
 * Copyright (c) 2021 dxcfl
 *
 * SPDX-License-Identifier: Apache-2.0
 */

#include <zephyr/types.h>
#include <stddef.h>
#include <zephyr/sys/printk.h>
#include <zephyr/sys/util.h>

#include <zephyr/bluetooth/bluetooth.h>
#include <zephyr/bluetooth/hci.h>

#include <zephyr/logging/log.h>

#include "beacon.h"

LOG_MODULE_REGISTER(beacon, LOG_LEVEL_DBG);

#define DEVICE_NAME CONFIG_BT_DEVICE_NAME
#define DEVICE_NAME_LEN (sizeof(DEVICE_NAME) - 1)

#define MY_BEACON_TYPE_EDDYSTONE
// #define MY_BEACON_TYPE_IBEACON

#ifdef MY_BEACON_TYPE_IBEACON

#ifndef IBEACON_RSSI
#define IBEACON_RSSI 0xc8
#endif

/* Bluetooth beacon setup ...
 * "stolen" from the Zephyr bluetooth beacon example
 * (zephyr/samples/bluetooth/ibeacon/main.c).
 * Setup a non-connectable iBeacon.
 * Later we will "abuse" the name data in the scan
 * resonse to transport the measure UV index.
 */

/*
 * Set iBeacon demo advertisement data. These values are for
 * demonstration only and must be changed for production environments!
 *
 * UUID:  18ee1516-016b-4bec-ad96-bcb96d166e97
 * Major: 0
 * Minor: 0
 * RSSI:  -56 dBm
 */
static const struct bt_data ad[] = {
	BT_DATA_BYTES(BT_DATA_FLAGS, BT_LE_AD_NO_BREDR),
	BT_DATA_BYTES(BT_DATA_MANUFACTURER_DATA,
				  0x4c, 0x00,						  /* Apple */
				  0x02, 0x15,						  /* iBeacon */
				  0x18, 0xee, 0x15, 0x16,			  /* UUID[15..12] */
				  0x01, 0x6b,						  /* UUID[11..10] */
				  0x4b, 0xec,						  /* UUID[9..8] */
				  0xad, 0x96,						  /* UUID[7..6] */
				  0xbc, 0xb9, 0x6d, 0x16, 0x6e, 0x97, /* UUID[5..0] */
				  0x00, 0x00,						  /* Major */
				  0x00, 0x00,						  /* Minor */
				  IBEACON_RSSI)						  /* Calibrated RSSI @ 1m */
};
#elif defined(MY_BEACON_TYPE_EDDYSTONE)

/* Bluetooth beacon setup ...
 * "stolen" from the Zephyr bluetooth beacon example
 * (zephyr/samples/bluetooth/beacon/main.c).
 * Setup a non-connectable Eddystone beacon.
 * Later we will "abuse" the name data in the scan
 * resonse to transport the measure UV index.
 */

/*
 * Set Advertisement data. Based on the Eddystone specification:
 * https://github.com/google/eddystone/blob/master/protocol-specification.md
 * https://github.com/google/eddystone/tree/master/eddystone-url
 */
static const struct bt_data ad[] = {
	BT_DATA_BYTES(BT_DATA_FLAGS, BT_LE_AD_NO_BREDR),
	BT_DATA_BYTES(BT_DATA_UUID16_ALL, 0xaa, 0xfe),
	BT_DATA_BYTES(BT_DATA_SVC_DATA16,
				  0xaa, 0xfe, /* Eddystone UUID */
				  0x10,		  /* Eddystone-URL frame type */
				  0x00,		  /* Calibrated Tx power at 0m */
				  0x00,		  /* URL Scheme Prefix http://www. */
				  'e', 'x', 'a', 'm', 'p', 'l', 'e',
				  0x08) /* .org */
};
#endif

/* Set Scan Response data */
static const struct bt_data sd[] = {
	BT_DATA(BT_DATA_NAME_COMPLETE, DEVICE_NAME, DEVICE_NAME_LEN),
	BT_DATA(BT_DATA_NAME_SHORTENED, DEVICE_NAME, DEVICE_NAME_LEN),
};

static void bt_ready(int err)
{
	char addr_s[BT_ADDR_LE_STR_LEN];
	bt_addr_le_t addr = {0};
	size_t count = 1;

	if (err)
	{
		LOG_ERR("Bluetooth init failed (err %d)", err);
		return;
	}
	LOG_INF("Bluetooth initialized");

	/* Start advertising */
	err = bt_le_adv_start(BT_LE_ADV_NCONN_IDENTITY, ad, ARRAY_SIZE(ad),
						  sd, ARRAY_SIZE(sd));
	if (err)
	{
		LOG_ERR("Advertising failed to start (err %d)", err);
		return;
	}

	/* For connectable advertising you would use
	 * bt_le_oob_get_local().  For non-connectable non-identity
	 * advertising an non-resolvable private address is used;
	 * there is no API to retrieve that.
	 */

	bt_id_get(&addr, &count);
	bt_addr_le_to_str(&addr, addr_s, sizeof(addr_s));

	LOG_INF("Bluetooth ready, advertising as %s", addr_s);
}

/*
 * Beacon start ...
 */
void beacon_start()
{
	/* Setup and start Bluetooth beacon
	 */
	int bt_err;
	LOG_INF("Starting beacon ...");
	bt_err = bt_enable(bt_ready);
	if (bt_err)
	{
		LOG_ERR("Beacon initiialization failed (err %d)", bt_err);
	}
}

/*
 * Beacon update ...
 */
void beacon_update_name(const char *name)
{
	beacon_update_names(name, strlen(name), DEVICE_NAME, DEVICE_NAME_LEN);
}

/*
 * Beacon update ...
 */
void beacon_update_names(const char *complete_name, size_t complete_name_length, const char *short_name, size_t short_name_length)
{
	int bt_err;

	if (complete_name == NULL || complete_name_length == 0)
	{
		LOG_ERR("Invalid complete name");
		return;
	}

	if (short_name == NULL || short_name_length == 0)
	{
		LOG_ERR("Invalid short name");
		return;
	}

	struct bt_data new_sd[] = {
		BT_DATA(BT_DATA_NAME_COMPLETE, complete_name, strlen(complete_name)),
		BT_DATA(BT_DATA_NAME_SHORTENED, short_name, strlen(short_name)),
	};
	LOG_DBG("Updating beacon with name '%s' ('%s')", complete_name, short_name);
	bt_err = bt_le_adv_update_data(ad, ARRAY_SIZE(ad),
								   new_sd, ARRAY_SIZE(new_sd));
	if (bt_err)
	{
		LOG_ERR("Advertising beacon update failed (err %d)", bt_err);
	}
}
```

## src/beacon.h
```c
/* beacon.h - BLE beacon */

/*
 * Copyright (c) 2015-2016 Intel Corporation
 * Copyright (c) 2021 dxcfl
 *
 * SPDX-License-Identifier: Apache-2.0
 */

#ifndef _BEACON_H
#define _BEACON_H

#ifdef __cplusplus
extern "C"
{
#endif

    /*
     * Beacon start ...
     */
    void beacon_start();

    /*
     * Beacon update ...
     */
    void beacon_update_name(const char *name);

    /*
     * Beacon update ...
     */
    void beacon_update_names(const char *complete_name, size_t complete_name_length, const char *short_name, size_t short_name_length);

#ifdef __cplusplus
}
#endif

#endif /* _BEACON_H */
```
